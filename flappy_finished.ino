#include <SPI.h>
#include <Adafruit_GFX.h>
#include <Adafruit_ST7735.h>
#include <EEPROM.h>

#define JOYSTICK_PIN 3

#define lcd_cs  9
#define dc  8
#define rst 7

#define GAME_HEIGHT 128
#define GAME_WIDTH 160
#define EEPROM_ADDRESS 0

#define FLAPPY_HEIGHT 11
#define FLAPPY_WIDTH 16
#define FLOOR_SIZE 10
#define FLOOR_EDGE 2
#define BLUE_ZONE 116
#define COL_A 59
#define COL_B 57
#define PILAR_WIDTH 10
#define MIN_SIZE 50
Adafruit_ST7735 tft = Adafruit_ST7735(lcd_cs, dc, rst);

 /*Variables a utilizar, ambito global para facilitar desarrollo */
//int MIN_SIZE = 60;
int scorecounter = 0;
int choosing = 0;
int posFloor = GAME_WIDTH-(FLOOR_SIZE+FLOOR_EDGE);
int posFlappyX, posFlappyY, flappySpeed;
//Variables del pilar
int userScore; /*Puntuacion actual del usuario*/
int pilares = 0;
int newHighScore = 0; /*Puntuacion maxima del usuario*/
bool gameActive = false;
bool crashed = false;
int pilar_speed = 0;
int x = GAME_WIDTH;
int y = random(20,116);
int contador_estabilidad = 0;
int testingx = 38;
int testingy = 60;
 /*Cargamos la imagen inicial*/
void imagen_inicial(){
  
static const uint8_t PROGMEM imagen[] = {
0xff, 0xff, 0xff, 0xff, 0xff, 0xff, 0xff, 0xff, 0xff, 0xff, 0xff, 0xff, 0xff, 0xff, 0xff, 0xff, 0xff, 0xff, 0xff, 0xff, 
0xff, 0xff, 0xff, 0xff, 0xff, 0xff, 0xff, 0xff, 0xff, 0xff, 0xff, 0xff, 0xff, 0xff, 0xff, 0xff, 0xff, 0xff, 0xff, 0xff, 
0xff, 0xff, 0xff, 0xff, 0xff, 0xff, 0xff, 0xff, 0xff, 0xff, 0xff, 0xff, 0xff, 0xff, 0xff, 0xff, 0xff, 0xff, 0xff, 0xff, 
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0xff, 0xff, 0xff, 0xff, 0xff, 0xff, 0xff, 0xff, 0xff, 0xff, 0xff, 0xff, 0xff, 0xff, 0xff, 0xff, 0xff, 0xff, 0xff, 0xff
};

tft.drawBitmap(0, 0, imagen, 160, 128, ST7735_BLACK);
}

 /*Eliminamos el pato*/
void clear_flappy_sprite(int x, int y) {
 tft.fillRect(x, y, 16, 11, ST7735_BLUE); 
}

 /*Pintar al pato*/
void draw_flappy_sprite(int x, int y) {
  tft.drawFastHLine(x+5,y,5,ST7735_BLACK);
  
  tft.drawFastHLine(x+3,y+1,1,ST7735_BLACK);
  tft.drawFastHLine(x+5,y+1,1,ST7735_YELLOW);
  tft.drawPixel(x+7,y+1,ST7735_BLACK);
  tft.drawFastHLine(x+8,y+1,2,ST7735_WHITE);
  tft.drawPixel(x+11,y+1,ST7735_BLACK);

  tft.drawPixel(x+2,y+2,ST7735_BLACK);
  tft.drawFastHLine(x+3,y+2,2,ST7735_YELLOW);
  tft.drawPixel(x+6,y+2,ST7735_BLACK);
  tft.drawFastHLine(x+7,y+2,2,ST7735_WHITE);
  tft.drawPixel(x+10,y+2,ST7735_BLACK);
  tft.drawPixel(x+11,y+2,ST7735_WHITE);
  tft.drawPixel(x+12,y+2,ST7735_BLACK);

  tft.drawFastHLine(x+1,y+3,1,ST7735_BLACK);
  tft.drawFastHLine(x+3,y+3,2,ST7735_YELLOW);
  tft.drawPixel(x+6,y+3,ST7735_BLACK);
  tft.drawFastHLine(x+7,y+3,2,ST7735_WHITE);
  tft.drawPixel(x+10,y+3,ST7735_BLACK);
  tft.drawFastHLine(x+11,y+3,1,ST7735_WHITE);
  tft.drawPixel(x+13,y+3,ST7735_BLACK);

  tft.drawPixel(x+1,y+4,ST7735_BLACK);
  tft.drawFastHLine(x+2,y+4,4,ST7735_YELLOW);
  tft.drawPixel(x+7,y+4,ST7735_BLACK);
  tft.drawFastHLine(x+8,y+4,4,ST7735_WHITE);
  tft.drawPixel(x+13,y+4,ST7735_BLACK);

  tft.drawPixel(x+1,y+5,ST7735_BLACK);
  tft.drawFastHLine(x+2,y+5,5,ST7735_YELLOW);
  tft.drawFastHLine(x+8,y+5,6,ST7735_BLACK);

  tft.drawPixel(x+1,y+6,ST7735_BLACK);
  tft.drawFastHLine(x+2,y+6,4,ST7735_YELLOW);
  tft.drawPixel(x+7,y+6,ST7735_BLACK);
  tft.drawFastHLine(x+8,y+6,6,ST7735_RED);
  tft.drawPixel(x+15,y+6,ST7735_BLACK);

  tft.drawPixel(x+1,y+7,ST7735_BLACK);
  tft.drawFastHLine(x+2,y+7,3,ST7735_YELLOW);
  tft.drawPixel(x+6,y+7,ST7735_BLACK);
  tft.drawPixel(x+7,y+7,ST7735_RED);
  tft.drawFastHLine(x+8,y+7,6,ST7735_BLACK);

  tft.drawPixel(x+1,y+8,ST7735_BLACK);
  tft.drawFastHLine(x+2,y+8,4,ST7735_YELLOW);
  tft.drawPixel(x+7,y+8,ST7735_BLACK);
  tft.drawFastHLine(x+8,y+8,5,ST7735_RED);
  tft.drawPixel(x+14,y+8,ST7735_BLACK);

  tft.drawFastHLine(x+2,y+9,1,ST7735_BLACK);
  tft.drawFastHLine(x+4,y+9,3,ST7735_YELLOW);
  tft.drawFastHLine(x+8,y+9,5,ST7735_BLACK);

  tft.drawFastHLine(x+4,y+10,4,ST7735_BLACK);

}

// Ala hacia abajo
void draw_wing_down(int x, int y) {
  tft.fillRect(x, y+7, 1, 3, ST7735_BLACK);
  tft.fillRect(x+1, y+10, 4, 1, ST7735_BLACK);
  tft.fillRect(x+1, y+6, 5, 1, ST7735_BLACK);
  tft.fillRect(x+6, y+7, 1, 1, ST7735_BLACK);
  tft.fillRect(x+5, y+8, 1, 1, ST7735_BLACK);
  tft.fillRect(x+1, y+7, 4, 3, ST7735_WHITE);
  tft.fillRect(x+4, y+9, 1, 1, ST7735_BLACK);
  tft.fillRect(x+5, y+7, 1, 1, ST7735_WHITE);
}


// Ala hacia arriba
void draw_wing_up(int x, int y) {
  tft.fillRect(x+1, y+3, 4, 1, ST7735_BLACK);
  tft.fillRect(x, y+4, 1, 3, ST7735_BLACK);
  tft.fillRect(x+5, y+4, 1, 1, ST7735_BLACK);
  tft.fillRect(x+6, y+5, 1, 2, ST7735_BLACK);
  tft.fillRect(x+5, y+7, 1, 1, ST7735_BLACK);
  tft.fillRect(x+1, y+7, 1, 1, ST7735_BLACK);
  tft.fillRect(x+2, y+8, 3, 1, ST7735_BLACK);
  tft.fillRect(x+1, y+4, 4, 3, ST7735_WHITE);
  tft.fillRect(x+2, y+7, 3, 1, ST7735_WHITE);
  tft.fillRect(x+5, y+5, 1, 2, ST7735_WHITE);
}

void draw_obstacules(int x,int y) { //Creacion de pilares
    if(y>=COL_A){
      tft.fillRect(x,y,PILAR_WIDTH,BLUE_ZONE-y,ST7735_MAGENTA);
      tft.fillRect(x,0,PILAR_WIDTH,y-MIN_SIZE,ST7735_MAGENTA);
    }  
    if(y<=COL_B){
      tft.fillRect(x,0,PILAR_WIDTH,y,ST7735_MAGENTA);
      tft.fillRect(x,y+MIN_SIZE,PILAR_WIDTH,BLUE_ZONE - (y+MIN_SIZE),ST7735_MAGENTA);
    }
}

void clear_obstacules(int x,int y){ //Limpieza de pilares
    if(y>=COL_A){
      tft.fillRect(x,y,PILAR_WIDTH,BLUE_ZONE-y,ST7735_BLUE);
      tft.fillRect(x,0,PILAR_WIDTH,y-MIN_SIZE,ST7735_BLUE);
    }
    if(y<=COL_B){
      tft.fillRect(x,0,PILAR_WIDTH,y,ST7735_BLUE);
      tft.fillRect(x,y+MIN_SIZE,PILAR_WIDTH,BLUE_ZONE - (y+MIN_SIZE),ST7735_BLUE);      
    }  
}
void check_flappy_hit() {
  //Colision con el suelo
  if (posFlappyY == GAME_HEIGHT - (FLOOR_SIZE + FLOOR_EDGE) - FLAPPY_HEIGHT) {
    crashed = true;
    clear_obstacules(x,y);
  } 
  //Colision con pilares
  if((y>=COL_A && x==posFlappyX) || (y>=COL_A && x==posFlappyX+1) || (y>=COL_A && x==posFlappyX-1)){
    if((posFlappyY<=y-MIN_SIZE)||(posFlappyY > y)){
      crashed = true;
      clear_obstacules(x,y);
    }
  }
  if((y<=COL_B && x==posFlappyX) || (y<=COL_B && x==posFlappyX+1) || (y<=COL_B && x==posFlappyX-1)){
    if((posFlappyY < y) || (posFlappyY > y+MIN_SIZE)){
      crashed = true;
      clear_obstacules(x,y);
    }
  }
  //Si colisiona
  if (crashed) { //Si se activa crashed en la comprobacion anterior, se para el juego y se muestra la puntuación
    tft.setCursor(43,70);
    tft.setTextSize(1);
    tft.setTextColor(ST7735_RED);
    tft.print("Pilares: ");
    tft.print(pilares);
    pilares = 0;
    clear_obstacules(x,y);
    tft.setTextColor(ST7735_RED);
    tft.setTextSize(2);
    tft.setCursor(25, 30);
    tft.print("Game Over!");
    tft.setCursor(38, 60);
    tft.setTextSize(0.9);
    tft.print("userScore:");
    tft.print(userScore);
    posFlappyY = 40;
    set_y_value();
    set_x_value(GAME_WIDTH);
    if (userScore > newHighScore) {
      newHighScore = userScore;
      EEPROM.write(0, newHighScore);
      tft.setCursor(30, 90);
      tft.print("NEW RECORD!");
    }
    // paramos de pintar
    gameActive = false;
    delay(1000);
  }
}

void drawing_loop() {

  //aumentar_dificultad();
  if(x<=5){ //Para que se creen nuevas columnas aleastorias
    clear_obstacules(x,y);
    set_y_value();
    set_x_value(GAME_WIDTH);
    draw_obstacules(x,y);
  }   //Aumento de Score cuando Flappy pasa por la columna
  if(!crashed && x == posFlappyX){
    tft.fillRect(140,120,10,15,ST7735_GREEN);
    pilares++;
    userScore += 10;
  }
  clear_flappy_sprite(posFlappyX, posFlappyY);
  pilar_speed++;
  if (gameActive) { // Actualizar velocidad de caida de flappy y pilar
    posFlappyY += flappySpeed;
    flappySpeed++;
    if(pilar_speed == 1){ //Movimiento de Pilares con velocidad
      clear_obstacules(x,y);
      draw_obstacules(x = x-1,y);
      pilar_speed = 0;
    }
  }
  if( posFlappyY+FLAPPY_HEIGHT > GAME_HEIGHT-FLOOR_SIZE-FLOOR_EDGE){
    posFlappyY = GAME_HEIGHT-FLAPPY_HEIGHT-FLOOR_SIZE-FLOOR_EDGE;
  }else if(posFlappyY < 0){
    posFlappyY = 0;
  }
  draw_flappy_sprite(posFlappyX, posFlappyY);

  if(flappySpeed < 0) {
    draw_wing_down(posFlappyX,posFlappyY);
  }else{
    draw_wing_up(posFlappyX,posFlappyY);
  }
}
/*
void aumentar_dificultad(){
  if(pilares == 2 && MIN_SIZE != 30){
    MIN_SIZE -= 24;
    pilares = 0;
  }
}*/
void start_game(){
  posFlappyX=50;
  posFlappyY=40;
  flappySpeed=1;
  crashed = false;
  newHighScore = EEPROM.read(EEPROM_ADDRESS);
  userScore = 0;
  
  tft.fillScreen(ST7735_BLUE);
  tft.setTextColor(ST7735_WHITE);
  tft.setTextSize(2);
  tft.setCursor(15, 10);
  tft.println("Flappy Bird");
  tft.setTextSize(1);
  tft.setCursor(38, 60);
  tft.println("PRESS TO START");

  tft.fillRect(0,GAME_HEIGHT-FLOOR_SIZE-FLOOR_EDGE,GAME_WIDTH,FLOOR_EDGE,ST7735_BLACK);
  tft.fillRect(0,GAME_HEIGHT-FLOOR_SIZE, GAME_WIDTH, FLOOR_SIZE, ST7735_GREEN);

  while(digitalRead(JOYSTICK_PIN) != LOW){/*esperar al usuario*/}
  tft.fillRect(0,0,GAME_WIDTH,GAME_HEIGHT-FLOOR_SIZE-FLOOR_EDGE,ST7735_BLUE);
}

void setup() {
  
  tft.initR(INITR_BLACKTAB);
  digitalWrite(JOYSTICK_PIN,INPUT_PULLUP);
  
  tft.setRotation(1);
  tft.fillScreen(ST7735_WHITE);
  
  imagen_inicial();
  
  delay(5000);
  start_game();
    
}

int set_x_value(int newx)
{
  x = newx;
  return x;
}

int set_y_value()
{
  y = random(20,116);
  return y;
}

void loop() {
  if (millis() % 30 == 0 && !crashed) { //Cada 30 ms si no se ha estrellado, hacemos el loop de dibujar y comprobar si choca
    scorecounter++;
    tft.setCursor(98,120);
    tft.setTextSize(0.1);
    tft.setTextColor(ST7735_BLACK);
    tft.print("Score:");
    tft.setTextColor(ST7735_BLACK);
    tft.setCursor(140,120);
    tft.setTextSize(0.1);
    tft.print(userScore);
    drawing_loop();
    check_flappy_hit(); //funcion para comprobar si choca el flappy con las tuberias o con el suelo
  }
    
    // Leer joystick
    if (digitalRead(JOYSTICK_PIN) == LOW) {
      if (crashed){
        clear_obstacules(x,y);
        start_game();
      }else if (!gameActive) {//iniciar animación
        gameActive = true;
      }else { //reduce su caida, vuela hacia arriba
        if(posFlappyY > GAME_HEIGHT - 90)
          flappySpeed = -6; 
      }
    }
}
